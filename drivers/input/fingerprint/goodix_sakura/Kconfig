## drivers/input/fingerprint/goodix_sakura/Kconfig
```kconfig
config FINGERPRINT_GOODIX_GF3208_SAKURA
	tristate "generic goodix fingerprint driver"
	depends on INPUT_FINGERPRINT
	help
	    Say Y here to enable goodix fingerprint driver support!
```
